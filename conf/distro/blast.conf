## conf/distro/blast.conf
```bitbake
require conf/distro/poky.conf
DISTRO = "blast"
DISTRO_NAME = "Blast Dist"
DISTRO_VERSION = "1.0"
DISTRO_CODENAME = "blast"

DISTRO_FEATURES = "${DISTRO_FEATURES_LIBC} alsa ext largefile wifi xattr opengl usbgadget \
                    usbhost pci systemd wayland x11 pam"

VIRTUAL-RUNTIME_init_manager = "systemd"

DISTRO_FEATURES_BACKFILL_CONSIDERED = "sysvinit"

VIRTUAL-RUNTIME_initscripts = ""

PACKAGE_CLASSES = "package_ipk"

#PREFERRED_PROVIDER_virtual/kernel = "linux-yocto"
```

## conf/layer.conf
```bitbake
# We have a conf and classes directory, add to BBPATH
BBPATH =. "${LAYERDIR}:"

# We have recipes-* directories, add to BBFILES
BBFILES += "${LAYERDIR}/recipes-*/*/*.bb \
            ${LAYERDIR}/recipes-*/*/*.bbappend"

BBFILE_COLLECTIONS += "blast"
BBFILE_PATTERN_blast = "^${LAYERDIR}/"
BBFILE_PRIORITY_blast = "10"

FSL_EULA_FILE = "${LAYERDIR}/EULA"

FSL_MIRROR ?= "http://www.freescale.com/lgfiles/NMG/MAD/YOCTO/"

MIRRORS += " \
${FSL_MIRROR}	http://download.ossystems.com.br/bsp/freescale/source/ \n \
"
```

## conf/machine/udoo-quad.conf
```bitbake
#@TYPE: Machine
#@NAME: UDOO Quad
#@SOC: i.MX6Q
#@DESCRIPTION: Machine configuration for UDOO Quad

include conf/machine/include/imx-base.inc
include conf/machine/include/tune-cortexa9.inc

SOC_FAMILY = "mx6:mx6q:udoo"

PREFERRED_PROVIDER_virtual/bootloader ?= "u-boot"

PREFERRED_PROVIDER_virtual/kernel ?= "linux-udoo"

IMAGE_BOOTLOADER = "u-boot"
EXTRA_IMAGEDEPENDS = "u-boot"
UBOOT_MAKE_TARGET = "u-boot.imx"
UBOOT_SUFFIX = "imx"
UBOOT_MACHINE = "udoo_config"

MACHINE_ESSENTIAL_EXTRA_RDEPENDS += " kernel-devicetree "
MACHINE_EXTRA_RRECOMMENDS = "kernel-modules"

KERNEL_DEVICETREE = "imx6q-udoo.dtb"

SERIAL_CONSOLE = "115200 ttymxc1"

MACHINE_FEATURES += " pci wifi"

DEFAULTTUNE = "cortexa9hf-neon"

IMAGE_FSTYPES ??= "tar.bz2"
```
